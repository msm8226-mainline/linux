## Documentation/devicetree/bindings/input/touchscreen/cypress,cy8ctma460.yaml
```yaml
# SPDX-License-Identifier: (GPL-2.0-only OR BSD-2-Clause)
%YAML 1.2
---
$id: http://devicetree.org/schemas/input/touchscreen/cypress,cy8ctma460.yaml#
$schema: http://devicetree.org/meta-schemas/core.yaml#

title: Cypress CY8CTMA460 series touchscreen controller

description: The Cypress CY8CTMA460 series (also known as "CYTTSP4" after
  the marketing name Cypress TrueTouch Standard Product) touchscreens can
  be connected to either I2C or SPI buses.

maintainers:
  - Erikas Bitovtas <xerikasxx@gmail.com>

allOf:
  - $ref: touchscreen.yaml#

properties:
  $nodename:
    pattern: "^touchscreen(@.*)?$"

  compatible:
    oneOf:
      - const: cypress,cy8ctma1036
      - const: cypress,cy8ctma460

  reg:
    description: I2C address when used on the I2C bus, or the SPI chip
      select index when used on the SPI bus

  clock-frequency:
    description: I2C client clock frequency, defined for host when using
      the device on the I2C bus
    minimum: 0
    maximum: 400000

  spi-max-frequency:
    description: SPI clock frequency, defined for host, defined when using
      the device on the SPI bus. The throughput is maximum 10 Mbps so the
      typical value is 10000000, if higher rates are used the total throughput
      needs to be restricted to 2 Mbps.
    minimum: 0
    maximum: 10000000

  interrupts:
    maxItems: 1

  vccd-supply:
    description: Analog power supply regulator

  vddd-supply:
    description: Digital power supply regulator

  reset-gpios:
    description: Reset line for the touchscreen. Active low.

  touchscreen-size-x: true
  touchscreen-size-y: true
  touchscreen-fuzz-x: true
  touchscreen-fuzz-y: true

additionalProperties: false

required:
  - compatible
  - reg
  - interrupts
  - touchscreen-size-x
  - touchscreen-size-y

examples:
  - |
    #include <dt-bindings/interrupt-controller/irq.h>
    #include <dt-bindings/gpio/gpio.h>
    &blsp_i2c5 {
      touchscreen@24 {
        compatible = "cypress,cy8ctma460";
        reg = <0x24>;
        interrupts-extended = <&tlmm 16 IRQ_TYPE_EDGE_FALLING>;
        reset-gpios = <&tlmm 17 GPIO_ACTIVE_LOW>;
        vdd-supply = <&pm8226_l27>;
        vcpin-supply = <&pm8226_l19>;
        touchscreen-size-x = <540>;
        touchscreen-size-y = <960>;
      };
    };

...
```

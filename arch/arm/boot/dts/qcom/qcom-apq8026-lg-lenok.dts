// SPDX-License-Identifier: BSD-3-Clause
/*
 * Copyright (c) 2021, Luca Weiss <luca@z3ntu.xyz>
 */

/dts-v1/;

#include "qcom-msm8226.dtsi"
#include "qcom-apq8026-lg-common.dtsi"

/ {
	model = "LG G Watch R";
	compatible = "lg,lenok", "qcom,apq8026";
	chassis-type = "watch";
	qcom,board-id = <132 0x0a>;
	qcom,msm-id = <199 0x20000>;
};



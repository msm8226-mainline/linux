// SPDX-License-Identifier: BSD-3-Clause
/*
 * Copyright (c) 2022, Matti Lehtimäki <matti.lehtimaki@gmail.com>
 * Copyright (c) 2023, Stefan Hansson <newbyte@postmarketos.org>
 */

/dts-v1/;

#include "msm8926.dtsi"
#include "qcom-msm8226-samsung-matisse-common.dtsi"

/ {
	model = "Samsung Galaxy Tab 4 10.1 LTE";
	compatible = "samsung,matisselte", "qcom,msm8926", "qcom,msm8226";
	chassis-type = "tablet";
};

&modem {
	mss-supply = <&pm8226_s5>;
};
